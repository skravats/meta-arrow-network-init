## conf/layer.conf
```bitbake
# We have a conf and classes directory, add to BBPATH
BBPATH .= ":${LAYERDIR}"

# We have recipes-* directories, add to BBFILES
BBFILES += "${LAYERDIR}/recipes-*/*/*.bb \
            ${LAYERDIR}/recipes-*/*/*.bbappend"

BBFILE_COLLECTIONS += "meta-arrow-network-init"
BBFILE_PATTERN_meta-arrow-network-init = "^${LAYERDIR}/"
BBFILE_PRIORITY_meta-arrow-network-init = "6"

LAYERDEPENDS_meta-arrow-network-init = "core"
LAYERSERIES_COMPAT_meta-arrow-network-init = "warrior"
```
